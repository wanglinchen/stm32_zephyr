## boards/apollo_f429/board.yml
```yaml
board:
  name: apollo_f429
  full_name: ALIENTEK Apollo V2 (STM32F429IGT6)
  vendor: alientek
  socs:
    - name: stm32f429xx
```

## modules/apollo_f429/dts/bindings/audio/everest,es8388.yaml
```yaml
# SPDX-License-Identifier: Apache-2.0
description: |
  Everest ES8388 stereo audio codec, I2C control port only.
  The audio data path (SAI1 / I2S) is described by the SoC SAI node.

compatible: "everest,es8388"

include: [i2c-device.yaml]

properties:
  reset-gpios:
    type: phandle-array
    description: Optional codec reset pin.
```

## modules/apollo_f429/dts/bindings/input/alientek,ir-nec.yaml
```yaml
# SPDX-License-Identifier: Apache-2.0
description: |
  NEC infrared remote receiver (LF0038 style, active-low output).

compatible: "alientek,ir-nec"

include: base.yaml

properties:
  gpios:
    type: phandle-array
    required: true
    description: Receiver output pin, active low.
```

## modules/apollo_f429/dts/bindings/nand/alientek,mt29f4g08.yaml
```yaml
# SPDX-License-Identifier: Apache-2.0
description: |
  Micron MT29F4G08 (4Gbit, 8-bit) NAND flash connected to the STM32 FMC
  NAND bank 2 (NCE2 on PG9 / 0x70000000).  The driver programs FMC bank 2
  itself because Zephyr has no FMC NAND controller driver.

compatible: "alientek,mt29f4g08"

include: base.yaml

properties:
  reg:
    required: true

  block-size:
    type: int
    default: 131072
    description: Erase block size in bytes (64 pages * 2048 B).

  page-size:
    type: int
    default: 2048
    description: Page (main area) size in bytes.
```

## modules/apollo_f429/dts/bindings/sensor/alientek,ap3216c.yaml
```yaml
# SPDX-License-Identifier: Apache-2.0
description: |
  Lite-On AP3216C ambient light / proximity sensor on I2C.

compatible: "alientek,ap3216c"

include: [sensor-device.yaml, i2c-device.yaml]
```

## modules/apollo_f429/dts/bindings/sensor/alientek,dht11.yaml
```yaml
# SPDX-License-Identifier: Apache-2.0
description: |
  DHT11 / DS18B20 single-wire sensor on a GPIO (ATK 阿波罗 U10 接口，PB12)。

compatible: "alientek,dht11"

include: sensor-device.yaml

properties:
  gpios:
    type: phandle-array
    required: true
    description: Single-wire data pin, open-drain style with external pull-up.
```
