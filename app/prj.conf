## CMakeLists.txt
```
# SPDX-License-Identifier: Apache-2.0
# 应用入口：Zephyr 通过 find_package(Zephyr) 注入内核、驱动与链接脚本
cmake_minimum_required(VERSION 3.20.0)

# 自定义板与 out-of-tree 驱动模块都在本仓库内，必须在 find_package(Zephyr) 之前登记。
# 这样 IDE 直接打开、裸 cmake 配置、以及 scripts/build.ps1 三种入口都能找到它们，
# 不再依赖命令行上的 -DBOARD_ROOT / -DZEPHYR_EXTRA_MODULES。
get_filename_component(app_project_root "${CMAKE_CURRENT_SOURCE_DIR}/.." ABSOLUTE)

# 裸 cmake / IDE 场景：Zephyr 的配置脚本需要 pyelftools、jsonschema、pykwalify 等包。
# scripts/env.ps1 把解释器放在环境变量 WEST_PYTHON 里，而 zephyr/cmake/modules/python.cmake
# 只在 CMake 变量 WEST_PYTHON / Python3_EXECUTABLE 已定义时才采用它（west build 会代转），
# 这里补上这一步，避免 CMake 自己搜到系统里缺包的解释器。
if(NOT DEFINED Python3_EXECUTABLE AND DEFINED ENV{WEST_PYTHON})
  file(TO_CMAKE_PATH "$ENV{WEST_PYTHON}" _west_python)
  if(EXISTS "${_west_python}")
    set(Python3_EXECUTABLE "${_west_python}")
  endif()
endif()

# 规范化已有条目（命令行或 CMakeCache 里可能是反斜杠路径），避免同一目录被判成两项
if(DEFINED BOARD_ROOT)
  set(_board_root_normalized "")
  foreach(_entry IN LISTS BOARD_ROOT)
    file(TO_CMAKE_PATH "${_entry}" _entry_norm)
    list(APPEND _board_root_normalized "${_entry_norm}")
  endforeach()
  set(BOARD_ROOT "${_board_root_normalized}")
else()
  set(BOARD_ROOT "")
endif()
list(FIND BOARD_ROOT "${app_project_root}" _board_root_index)
if(_board_root_index EQUAL -1)
  list(APPEND BOARD_ROOT "${app_project_root}")
endif()

if(DEFINED ZEPHYR_EXTRA_MODULES)
  set(_extra_modules_normalized "")
  foreach(_entry IN LISTS ZEPHYR_EXTRA_MODULES)
    file(TO_CMAKE_PATH "${_entry}" _entry_norm)
    list(APPEND _extra_modules_normalized "${_entry_norm}")
  endforeach()
  set(ZEPHYR_EXTRA_MODULES "${_extra_modules_normalized}")
else()
  set(ZEPHYR_EXTRA_MODULES "")
endif()
list(FIND ZEPHYR_EXTRA_MODULES "${app_project_root}/modules/apollo_f429" _module_index)
if(_module_index EQUAL -1)
  list(APPEND ZEPHYR_EXTRA_MODULES "${app_project_root}/modules/apollo_f429")
endif()

find_package(Zephyr HINTS $ENV{ZEPHYR_BASE})
project(stm32f429_zephyr_app VERSION 0.1.0 LANGUAGES C)

# 应用层：每个模块一个源文件，头文件集中在 include/
# app_devices.c：`devices` shell 命令，用于板载模块自检
target_sources(app PRIVATE
    src/main.c
    src/app_led.c
    src/app_shell.c
    src/app_devices.c
)

target_include_directories(app PRIVATE include)
```

## prj.conf
```kconfig
# ============================================================
# STM32F429 + Zephyr 4.5 应用配置
# 只写“能力开关”，具体数值由 board/soc defconfig 与 devicetree 提供
# ============================================================

# ---- 内核 ----
CONFIG_MAIN_STACK_SIZE=2048
CONFIG_SYSTEM_WORKQUEUE_STACK_SIZE=2048
CONFIG_THREAD_NAME=y
CONFIG_THREAD_STACK_INFO=y
CONFIG_ASSERT=y
CONFIG_INIT_STACKS=y
CONFIG_BOOT_BANNER=y

# ---- 设备驱动 ----
CONFIG_GPIO=y
CONFIG_SERIAL=y
CONFIG_CONSOLE=y
CONFIG_UART_CONSOLE=y
CONFIG_PRINTK=y

# ---- 日志：延迟模式，中断里只入缓冲，由日志线程输出 ----
CONFIG_LOG=y
CONFIG_LOG_MODE_DEFERRED=y
CONFIG_LOG_DEFAULT_LEVEL=3
CONFIG_LOG_BUFFER_SIZE=4096
CONFIG_LOG_BACKEND_UART=y
CONFIG_LOG_BACKEND_UART_OUTPUT_TEXT=y

# ---- Shell ----
CONFIG_SHELL=y
CONFIG_SHELL_STACK_SIZE=2048
CONFIG_SHELL_HISTORY=y

# ---- 系统服务 ----
CONFIG_REBOOT=y
CONFIG_WATCHDOG=y
```

## boards/apollo_f429.conf
```kconfig
# ============================================================
# apollo_f429 专用：把板上各模块对应的驱动子系统打开
# 板级 devicetree 已经声明节点，这里只打开“能力开关”
# ============================================================

CONFIG_MAIN_STACK_SIZE=4096
# 日志为 deferred 模式：8KB 缓冲对本应用（约 20 条日志）严重过剩，1024 B 足够
CONFIG_LOG_BUFFER_SIZE=1024

# ---- 总线 ----
CONFIG_SPI=y                    # SPI5(W25Q256) + spi-bitbang(XPT2046)
CONFIG_I2C=y                    # I2C2(EEPROM/PCF8574/IMU/光感/气压/编解码)

# ---- 存储 ----
CONFIG_FLASH=y
CONFIG_FLASH_PAGE_LAYOUT=y      # NAND 页布局 (mt29f4g08)
CONFIG_SPI_NOR=y                # W25Q256
# 注：Zephyr 4.5 已不再提供 AT24/24C02 的 I2C devicetree 驱动，
#     板上 24C02 目前通过 i2c2 直接读写（详见 docs/模块-驱动对照表.md）

# ---- 传感器 ----
CONFIG_SENSOR=y                 # QMI8658A / AP3216C / DHT11

# ---- 显示 / 触摸 ----
CONFIG_DISPLAY=y                # LTDC + 8080 并口屏
CONFIG_INPUT=y                  # XPT2046 触摸

# ---- 模拟 ----
CONFIG_ADC=y
CONFIG_ADC_STM32=y              # ADC1（PA5 电位器/电池检测）
CONFIG_DAC=y                    # DAC1（PA4）

# ---- 其他片上外设 ----
CONFIG_RTC=y
```

## boards/stm32f429i_disc1.conf
```kconfig
# 板级能力开关（仅 STM32F429I-DISC1 生效）
# 本板 RAM 相对充裕，主栈与日志缓冲给足，便于调试期抓现场
CONFIG_MAIN_STACK_SIZE=3072
CONFIG_LOG_BUFFER_SIZE=8192
```

## boards/apollo_f429.overlay
```dts
/ {
	aliases {
		app-heartbeat-led = &green_led;
	};
};
```

## boards/stm32f429i_disc1.overlay
```dts
/*
 * 板级硬件差异层：只描述“这块板子”的事实，不动应用逻辑。
 * Zephyr 构建时自动加载 app/boards/<board>.overlay。
 */
/ {
	aliases {
		/* 运行指示改用 LD4（PG14），LD3 留给业务状态 */
		app-heartbeat-led = &red_led_4;
	};
};

/* 控制台固定 USART1：PA9(TX) / PA10(RX)，115200 8N1 */
&usart1 {
	current-speed = <115200>;
};
```

## src/main.c
```c
#include <zephyr/kernel.h>
#include <zephyr/version.h>
#include <zephyr/logging/log.h>

#include "app_led.h"

LOG_MODULE_REGISTER(app_main, LOG_LEVEL_INF);

/*
 * 应用启动顺序（全部在 main 线程上下文，初始化级别 POST_KERNEL 之后）：
 *   1. 业务模块自检（驱动句柄是否 ready）
 *   2. 拉起各业务线程
 *   3. 主线程保持存活，业务负载交给专门线程
 */
int main(void)
{
	LOG_INF("board=%s soc=%s kernel=%s", CONFIG_BOARD, CONFIG_SOC, KERNEL_VERSION_STRING);

	int rc = app_led_init();
	if (rc != 0) {
		LOG_ERR("LED 模块初始化失败: %d", rc);
		return rc;
	}

	LOG_INF("应用初始化完成");

	while (true) {
		k_sleep(K_SECONDS(5));
	}
}
```

## include/app_led.h
```c
#ifndef APP_LED_H_
#define APP_LED_H_

/**
 * 初始化心跳线程（内部使用 devicetree 中的 led0 别名）。
 *
 * @return 0 成功，负值表示 GPIO 句柄不可用。
 */
int app_led_init(void);

/** 运行时修改心跳周期；0 表示停止翻转。 */
void app_led_set_period(unsigned int period_ms);

#endif /* APP_LED_H_ */
```

## src/app_devices.c
```c
#include <zephyr/kernel.h>
#include <zephyr/shell/shell.h>
#include <zephyr/device.h>
#include <zephyr/devicetree.h>

/*
 * 板载模块自检：逐个检查 devicetree 里已声明、并且驱动确实实例化的设备，
 * 打印 device_is_ready() 结果，方便在现场用串口 shell 确认哪块外设可用。
 */

#define CHECK_NODE(node_id, tag)                                                   \
	do {                                                                        \
		if (DT_NODE_HAS_STATUS(node_id, okay)) {                             \
			const struct device *d = DEVICE_DT_GET(node_id);              \
			shell_print(sh, "%-12s %-18s %s", tag, d->name,              \
				    device_is_ready(d) ? "OK" : "FAIL");             \
		}                                                                   \
	} while (0)

#define CHECK_LABEL(label, tag)                                                    \
	do {                                                                        \
		if (DT_NODE_EXISTS(DT_NODELABEL(label))) {                           \
			CHECK_NODE(DT_NODELABEL(label), tag);                        \
		}                                                                   \
	} while (0)

static int cmd_devices(const struct shell *sh, size_t argc, char **argv)
{
	ARG_UNUSED(argc);
	ARG_UNUSED(argv);

	shell_print(sh, "%-12s %-18s %s", "模块", "设备名", "状态");

	/* 片上 */
	CHECK_NODE(DT_NODELABEL(usart1), "uart1");
	CHECK_NODE(DT_NODELABEL(usart2), "uart2");
	CHECK_NODE(DT_NODELABEL(usart3), "uart3");
	CHECK_NODE(DT_NODELABEL(rtc), "rtc");
	CHECK_NODE(DT_NODELABEL(i2c2), "i2c2");
	CHECK_NODE(DT_NODELABEL(spi5), "spi5");

	/* ADC1（PA5 通道） */
	CHECK_NODE(DT_NODELABEL(adc1), "adc1");

	/* 存储 */
	CHECK_LABEL(nand, "nand");
	CHECK_LABEL(w25q256, "w25q256");

	/* I2C 从设备 */
	CHECK_LABEL(pcf8574, "pcf8574");
	CHECK_LABEL(imu, "qmi8658a");
	CHECK_LABEL(light, "ap3216c");
	CHECK_LABEL(codec, "es8388");

	/* 单总线 / 红外 */
	CHECK_LABEL(w1_bus, "dht11");
	CHECK_LABEL(ir, "ir-nec");

	/* 显示 / 触摸 */
	CHECK_NODE(DT_NODELABEL(ltdc), "ltdc");
	CHECK_NODE(DT_CHOSEN(zephyr_touch), "touch");

	return 0;
}

SHELL_CMD_REGISTER(devices, NULL, "检查板载模块设备是否就绪", cmd_devices);
```

## src/app_led.c
```c
#include <zephyr/kernel.h>
#include <zephyr/drivers/gpio.h>
#include <zephyr/logging/log.h>

#include "app_led.h"

LOG_MODULE_REGISTER(app_led, LOG_LEVEL_INF);

/* 硬件描述来自 devicetree，不在这里硬编码端口和引脚。
 * app-heartbeat-led 别名由板级 overlay 提供，换板只改 overlay。
 */
#define LED_NODE DT_ALIAS(app_heartbeat_led)

#if !DT_NODE_EXISTS(LED_NODE)
#error "devicetree 中缺少 app-heartbeat-led 别名，请在 board overlay 中补充"
#endif

static const struct gpio_dt_spec led = GPIO_DT_SPEC_GET(LED_NODE, gpios);

K_THREAD_STACK_DEFINE(led_stack, 1024);
static struct k_thread led_thread_data;

static volatile unsigned int heartbeat_ms = 500;

static void led_entry(void *p1, void *p2, void *p3)
{
	ARG_UNUSED(p1);
	ARG_UNUSED(p2);
	ARG_UNUSED(p3);

	while (true) {
		unsigned int period = heartbeat_ms;

		if (period == 0U) {
			gpio_pin_set_dt(&led, 0);
			k_sleep(K_MSEC(100));
			continue;
		}

		gpio_pin_toggle_dt(&led);
		k_sleep(K_MSEC(period));
	}
}

int app_led_init(void)
{
	if (!gpio_is_ready_dt(&led)) {
		return -ENODEV;
	}

	int rc = gpio_pin_configure_dt(&led, GPIO_OUTPUT_INACTIVE);

	if (rc != 0) {
		return rc;
	}

	k_thread_create(&led_thread_data, led_stack, K_THREAD_STACK_SIZEOF(led_stack),
			led_entry, NULL, NULL, NULL, K_PRIO_PREEMPT(7), 0, K_NO_WAIT);
	k_thread_name_set(&led_thread_data, "led_heartbeat");

	LOG_INF("心跳线程已启动，周期 %ums", heartbeat_ms);
	return 0;
}

void app_led_set_period(unsigned int period_ms)
{
	heartbeat_ms = period_ms;
}
```

## src/app_shell.c
```c
#include <zephyr/kernel.h>
#include <zephyr/shell/shell.h>
#include <zephyr/version.h>
#include <stdlib.h>

#include "app_led.h"

static int cmd_info(const struct shell *sh, size_t argc, char **argv)
{
	ARG_UNUSED(argc);
	ARG_UNUSED(argv);

	shell_print(sh, "board      : %s", CONFIG_BOARD);
	shell_print(sh, "soc        : %s", CONFIG_SOC);
	shell_print(sh, "kernel     : %s", KERNEL_VERSION_STRING);
	shell_print(sh, "uptime     : %u ms", (uint32_t)k_uptime_get());
	shell_print(sh, "sysclk     : %u Hz", (uint32_t)CONFIG_SYS_CLOCK_HW_CYCLES_PER_SEC);
	return 0;
}

static int cmd_heartbeat(const struct shell *sh, size_t argc, char **argv)
{
	unsigned int period = (unsigned int)strtoul(argv[1], NULL, 10);

	app_led_set_period(period);
	shell_print(sh, "heartbeat period = %u ms%s", period, period == 0U ? "（已停止）" : "");
	return 0;
}

SHELL_STATIC_SUBCMD_SET_CREATE(app_sub,
	SHELL_CMD(info, NULL, "打印板级与内核信息", cmd_info),
	SHELL_CMD_ARG(heartbeat, NULL, "设置心跳周期：heartbeat <ms>，0 为停止", cmd_heartbeat, 2, 0),
	SHELL_SUBCMD_SET_END);

SHELL_CMD_REGISTER(app, &app_sub, "应用层命令", NULL);
```
